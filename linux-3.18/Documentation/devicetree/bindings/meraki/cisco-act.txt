## linux-3.18/drivers/net/ethernet/broadcom/gmac/et/Kconfig
```kconfig
#
# Copyright (C) 2013, Broadcom Corporation. All Rights Reserved.
# 
# Permission to use, copy, modify, and/or distribute this software for any
# purpose with or without fee is hereby granted, provided that the above
# copyright notice and this permission notice appear in all copies.
# 
# THE SOFTWARE IS PROVIDED "AS IS" AND THE AUTHOR DISCLAIMS ALL WARRANTIES
# WITH REGARD TO THIS SOFTWARE INCLUDING ALL IMPLIED WARRANTIES OF
# MERCHANTABILITY AND FITNESS. IN NO EVENT SHALL THE AUTHOR BE LIABLE FOR ANY
# SPECIAL, DIRECT, INDIRECT, OR CONSEQUENTIAL DAMAGES OR ANY DAMAGES
# WHATSOEVER RESULTING FROM LOSS OF USE, DATA OR PROFITS, WHETHER IN AN ACTION
# OF CONTRACT, NEGLIGENCE OR OTHER TORTIOUS ACTION, ARISING OUT OF OR IN
# CONNECTION WITH THE USE OR PERFORMANCE OF THIS SOFTWARE.
#
config GMAC_XGS_IPROC
	tristate "BRCM XGS iProc GMAC support "
	select ET
	select ET_ALL_PASSIVE_ON
	depends on ARCH_BCM_SWITCH_ARM
	default n
	help
	  Add GMAC support
	
	  If unsure, say N.

menu "BRCM XGS iProc GMAC options"
choice
	prompt "ET ALL PASSIVE mode"
	optional
config ET_ALL_PASSIVE_ON
	bool "ET ALL PASSIVE on"
config ET_ALL_PASSIVE_RUNTIME
	bool "ET ALL PASSIVE with runtime setting"
endchoice
config ET_NAPI2_POLL
	bool "BCM GMAC NAPI2_POLL"
	default n
	depends on !ET_ALL_PASSIVE_ON && !ET_ALL_PASSIVE_RUNTIME && ARCH_BCM_SWITCH_ARM
config BCM_IPROC_GMAC_ACP
	tristate "BCM GMAC_ACP support"
	depends on ARCH_BCM_SWITCH_ARM
	default n
	help
	  Add GMAC_ACP support to improve performance without
	  cache flushing/invalidate. The uboot's bootargs must
	  include "mem=240M" to limit whole Kernel memory inside
	  ACP region which is 256MB from 0x80000000; since kernel
	  starts from 0x81000000, total mem is 240MB only
	  If unsure, say N.
config BCM_IPROC_GMAC_PREFETCH
	tristate "BCM GMAC prefetching support"
	depends on ARCH_BCM_SWITCH_ARM
	default n
	help
	  If unsure, say N.
config BCM_IPROC_GMAC_TXONCPU1
	tristate "BCM GMAC TX-ON-CPU1 support"
	depends on SMP && (ET_ALL_PASSIVE_ON || ET_ALL_PASSIVE_RUNTIME) && ARCH_BCM_SWITCH_ARM
	default n
	help
	  Run "Passive Mode" Tx workthread on CPU1 for
	  multi-cores utilizing;
	  If unsure, say N.
config BCM_IPROC_GMAC_LOCK_OPT
	tristate "BCM GMAC LOCK OPTIMIZATION support"
	depends on ARCH_BCM_SWITCH_ARM
	default n
	help
	  Minimize locks during Tx/Rx tasks;
	  it is tested under "Passive Mode" (workthread) only.
	  If unsure, say N.
config BCM_IPROC_GMAC_RWREG_OPT
	tristate "BCM GMAC R/W_REG OPTIMIZATION support"
	depends on ARCH_BCM_SWITCH_ARM
	default n
	help
	  Remove unnecessary "DSB" intructions of R/W_REG Macro.
	  If unsure, say N.
config BCM_IPROC_GMAC_SG
	bool "BCM GMAC Scatter Gather support"
	depends on ARCH_BCM_SWITCH_ARM
	default n
config IPROC_SDK_MGT_PORT_HANDOFF
	bool "GMAC SDK Management port handoff"
	depends on ARCH_BCM_SWITCH_ARM
	default n
config IPROC_2STAGE_RX
	bool "GMAC 2 stage packet RX"
	depends on ARCH_BCM_SWITCH_ARM
	default n
config SERDES_ASYMMETRIC_MODE
	bool "GMAC SDK Serdes Asymmetric Mode"
	depends on ARCH_BCM_SWITCH_ARM
	default n
	depends on (MACH_KT2 || MACH_HX4)
config JUMBO_FRAME
	bool "GMAC Jumbo Frame Support"
	depends on ARCH_BCM_SWITCH_ARM
	default n
endmenu
```

## linux-3.18/drivers/poe/Kconfig
```kconfig
menuconfig POWER_OVER_ETHERNET
	tristate "Power over Ethernet support"
	help
	  Say Y here to enable Power over Ethernet (PoE) support.
	  This allows management of Power over Ethernet controllers
	  by the kernel, and monitoring/control from userspace.

config POE_PD690XX
	tristate "PD690xx PoE support"
	depends on POWER_OVER_ETHERNET
	help
	  Say Y to enable a driver for MicroSemi's PD690xx PoE
	  controllers in auto mode.

config POE_BCM59121
    tristate "BCM59121 PoE support"
    depends on POWER_OVER_ETHERNET
    help
      Say Y to enable a driver for Broadcom 59121 PoE
      controllers in auto mode.
```

## openwrt/package/bigreqsproto/Config.in
```kconfig
config BR2_PACKAGE_BIGREQSPROTO
        prompt "bigreqsproto........................Bigreqsproto extension headers"
	tristate
	default n
	help
	  Bigreqsproto extension headers. You probably only want this if you
	  install an X server.
```

## openwrt/package/blescan/Config.in
```kconfig
config BR2_PACKAGE_BLESCAN
	prompt "BLESCAN.............................. A file to scan bluetooth LE"
	tristate
	default n if CONFIG_DEVEL
        depends BR2_PACKAGE_LIBMBLUEZ
	help
		A small utility to spit out bluetooth low energy advertisements
```

## openwrt/package/busybox/Config.in
```kconfig
menu "busybox........................... The Swiss Army Knife of embedded Linux"

config BR2_PACKAGE_BUSYBOX
	prompt "busybox........................... The Swiss Army Knife of embedded Linux"
	bool
	default y
	help
	  The Swiss Army Knife of embedded Linux.  It slices, it dices, it
	  makes Julian Fries.
	  
	  http://busybox.net/
	  
	  Most people will answer Y.

config BR2_PACKAGE_BUSYBOX_STATIC_IN_STAGING
	prompt "busybox........................... create busybox-static in staging"
	bool
	depends BR2_PACKAGE_BUSYBOX
	default n
	help
	  put busybox-static in staging /bin for initrd

choice
	prompt "Busybox Version" if BR2_PACKAGE_BUSYBOX
	default BR2_BUSYBOX_VERSION_1_29
	depends BR2_PACKAGE_BUSYBOX
	help
	  Select the version of Busybox you wish to use.

	config BR2_PACKAGE_BUSYBOX_VERSION_1_1
	       bool "Busybox 1.1"

	config BR2_PACKAGE_BUSYBOX_VERSION_1_20
	       bool "Busybox 1.20"

	config BR2_PACKAGE_BUSYBOX_VERSION_1_23
               bool "Busybox 1.23"

	config BR2_PACKAGE_BUSYBOX_VERSION_1_24
               bool "Busybox 1.24.1"

	config BR2_PACKAGE_BUSYBOX_VERSION_1_25
		bool "Busybox 1.25.1"

	config BR2_PACKAGE_BUSYBOX_VERSION_1_29
		bool "Busybox 1.29.0"

endchoice

endmenu
```

## openwrt/package/cairo/Config.in
```kconfig
config BR2_PACKAGE_CAIRO
        prompt "cairo............................. Library for 2D graphics"
	tristate
	default n
	help
	  The cairo API provides a mechanism for 2D graphics.
```

## openwrt/package/click/Config.in
```kconfig
config BR2_PACKAGE_CLICK
	prompt "click............................. The Click Modular Router"
	tristate
	select BR2_PACKAGE_KMOD_TUN
	default m if CONFIG_DEVEL
	help
		http://pdos.csail.mit.edu/click/
```

## openwrt/package/conntrack/Config.in
```kconfig
config BR2_PACKAGE_CONNTRACK
	prompt "conntrack......................... Linux conntrack utility"
	tristate
	default m if CONFIG_DEVEL
	depends BR2_PACKAGE_LIBNETFILTER_CONNTRACK
	help
      linux conntrack package.
```

## openwrt/package/cryptsetup/Config.in
```kconfig
config BR2_PACKAGE_CRYPTSETUP
       prompt "cryptsetup......................... disk encryption utils"
	tristate
	default m if CONFIG_DEVEL
	help
           bleh

config BR2_PACKAGE_CRYPTSETUP_KERNEL
	prompt "   Use Linux kernel userspace crypto interface"
	bool
	default y
	depends BR2_PACKAGE_CRYPTSETUP
	help
	   Turn this off if your kernel doesn't support the crypto
	   interface.
```

## openwrt/package/damageproto/Config.in
```kconfig
config BR2_PACKAGE_DAMAGEPROTO
        prompt "damageproto.........................X damage extension protocol"
	tristate
	default n
	help
	  X damage extension protocol. You probably only need this if you
	  want to install an X server.
```

## openwrt/package/daq/Config.in
```kconfig
config BR2_PACKAGE_DAQ
	prompt "daq............................... Low-level network library"
	tristate
	default m if CONFIG_DEVEL
	depends BR2_PACKAGE_LIBDNET && BR2_PACKAGE_LIBPCAP && BR2_PACKAGE_LIBPCRE
	help
	  data acquisition library for packet i/o
	  from snort
	  
	  http://www.snort.org/snort-downloads
```

## openwrt/package/dmalloc/Config.in
```kconfig
config BR2_PACKAGE_DMALLOC
	prompt "dmalloc........................... The debug malloc library"
	tristate
	default n
	help
	  The debug malloc library
```

## openwrt/package/dmidecode/Config.in
```kconfig
config BR2_PACKAGE_DMIDECODE
	prompt "dmidecode......................... A client-side bios dmi decoder"
	tristate
	default m if CONFIG_DEVEL
	help
	  A client-side bios dmi decoder.

	  http://www.nongnu.org/dmidecode/
```

## openwrt/package/dnscrypt-proxy/Config.in
```kconfig
config BR2_PACKAGE_DNSCRYPT_PROXY
	prompt "DNSCrypt-Proxy....................... Secure communication with DNS server"
	tristate
	default y
	help
	  dnscrypt-proxy provides local service which can be used directly as your
	  local resolver or as a DNS forwarder, encrypting and authenticating requests
	  using the DNSCrypt protocol and passing them to an upstream server.
	  The DNSCrypt protocol uses high-speed high-security elliptic-curve cryptography
	  and is very similar to DNSCurve, but focuses on securing communications between
	  a client and its first-level resolver.

	  http://dnscrypt.org/
```

## openwrt/package/ffmpeg/Config.in
```kconfig
config BR2_PACKAGE_FFMPEG
	prompt "ffmpeg............................ Record, convert, and stream video"
	tristate
	default n
	help
	  Cross-platform solution to record, convert and stream video.
```

## openwrt/package/fftw3/Config.in
```kconfig
config BR2_PACKAGE_LIBFFTW
	prompt "libfftw3.......................... FFT library"
	tristate
	default m if CONFIG_DEVEL
	help
	  Developpment library from fftw3
```
