## linux-3.18/Documentation/devicetree/bindings/meraki/cisco-act.txt
```
Bindings for i2c ACT2 driver

Required properties:
- compatible : "act2"
- reg : Address of the device on the i2c bus.
- reset : GPIO pin to reset act2 device
- type : The TAM chip family. Valid options are:
         - TAM_FAMILY_ACT2
         - TAM_FAMILY_FPGA

Optional properties:
- write_buf_size : 16-bit value. Device has a minumum 48 byte write buffer
  requirement.  Maximum supported write buffer size is 259 bytes. If no buffer
  size is specified, defaults to minimum size. This buffer size is a requirement
  from the TAM library which needs to send commands to the device in one single
  bulk write.

Examples:

	act2@70 {
		compatible = "cisco,act2";
		reg = <0x70>;
		write_buf_size = /bits/ 16 <63>;
		reset = <&gpio_chip0 10 GPIO_ACTIVE_LOW>;
		type = <&gpio_chip0 10 GPIO_ACTIVE_LOW>;
	};
```

## linux-3.18/Documentation/devicetree/bindings/meraki/cisco-mps.txt
```
Bindings for Cisco Modular Power Supply driver

This is a platform device driver.

Required properties:
- compatible : "meraki,cisco-mps"
- id : Unique identifier used in the userspace endpoint's filename
    for the device
- reg-names : Addresses for devices on the i2c bus
    - "control-i2c" for address of the power control device
    - "data-i2c" for eeprom device
- power_good : Power_Good GPIO pin. Specify the gpio-controller
    devicetree node, then the pin number, then GPIO_ACTIVE_HIGH
    or GPIO_ACTIVE_LOW.
- present : PS_Present GPIO pin. Specify the gpio-controller
    devicetree node, then the pin number, then GPIO_ACTIVE_HIGH
    or GPIO_ACTIVE_LOW
-i2c : Reference to the i2c bus on which the power control and
    eeprom devices live.

Examples:

	psu1 {
		id = <1>;
		compatible = "meraki,cisco-mps";
		power_good = <&gpio_chip4 9 GPIO_ACTIVE_HIGH>;
		present = <&gpio_chip4 11 GPIO_ACTIVE_HIGH>;
		reg-names = "control-i2c", "data-i2c";
		reg = <0x5a 1>, <0x52 1>;
		i2c = <&i2c0>;
	};
```

## linux-3.18/Documentation/devicetree/bindings/meraki/gpio-config.txt
```
Bindings for iProc gpio config

Required properties:
- compatible : "iproc-gpio-cfg"

Optional properties:
- reg : Address and length of register sets for each device in
  "reg-names"
- reg-names : The names of the register addresses corresponding to the
  registers filled in "reg"
            cru-gpio-ctl: The base for CRU_GPIO_CONTROL registers. There should
                be nine GPIO control registers so the size should be 0x24.
            aux-sel: The GPIO Auxiliary logic select register. There is only one
                of these registers so the size should be 0x4.
- gpios-general : Specifies pins to be used as general gpio via
  the cru-gpio-ctl register. cru-gpio-ctl register must be present.
- gpios-aux : Specifies pins which have an aux function via the
  aux-fun-sel register. aux-sel register must be present.
- gpios-pullup : Specifies pins to be pulled up by an internal pull up
  register attached to each pin.

GPIO sub-node properties:
- gpios : Should specify the GPIO, see "gpios property" in
  Documentation/devicetree/bindings/gpio/gpio.txt. Active low GPIOs should
  be indicated using the flags in the GPIO specifier.
- direction : (optional) The direction of the pin. Valid values are "in"
  and "out". The default value is "in" if this property is not present.
- default-state : (optional) The initial state of the GPIO pin if it is
  an output. Valid values are "on", "off", and "keep". If the GPIO is
  already on or off and the default-state property is set to the same
  value, then no glish should be produced where the GPIO momentarily
  turns off (or on). The "keep" setting will keep the GPIO at whatever
  its current state is, without producing a glitch. The default value is
  keep if this property is not present.

Examples:

	gpio_chip5:gpio-controller@25 {
		gpio-controller;
		...
	};

	gpio-cfg {
		compatible = "iproc-gpio-cfg";
		reg-names = "cru-gpio-ctl", "aux-sel";
		reg = <0x1803f1c0 0x24>, <0x18030028 0x4>;
		gpios-general = <0 1 2 3 4 5 6 7 11 14 15 16 17 25 26 27 28 29 30 31>;
		gpios-aux = <33 34 35>;
		gpios-pullup = <14 15>;

		fan1-O {
			gpios = <&gpio_chip5 0 GPIO_ACTIVE_LOW>;
			default-state = "on";
			direction = "out";
		};
		fan1-G {
			gpios = <&gpio_chip5 1 GPIO_ACTIVE_LOW>;
			default-state = "off";
			direction = "out";
		};
	};
```

## linux-3.18/Documentation/devicetree/bindings/pci/brcm,iproc-pcie.txt
```
* Broadcom iProc PCIe controller

Required properties:
- compatible: set to "brcm,iproc-pcie"
- reg: base address and length of the PCIe controller and the MDIO interface
  that controls the PCIe PHY
- interrupts: INTx interrupt ID
- bus-range: PCI bus numbers covered
- #address-cells: set to <3>
- #size-cells: set to <2>
- device_type: set to "pci"
- ranges: ranges for the PCI memory and I/O regions
- phy-addr: MDC/MDIO adddress of the PCIe PHY
- have-msi-inten-reg: Required for legacy iProc PCIe controllers that need the
  MSI interrupt enable register to be set explictly

The Broadcom iProc PCie driver adapts the multi-domain structure, i.e., each
interface has its own domain and therefore has its own device node
Example:

SoC specific DT Entry:

	pcie0: pcie@18012000 {
		compatible = "brcm,iproc-pcie";
		reg = <0x18012000 0x1000>,
			<0x18002000 0x1000>;
		interrupts = <GIC_SPI 100 IRQ_TYPE_NONE>;
		bus-range = <0x00 0xFF>;

		#address-cells = <3>;
		#size-cells = <2>;
		device_type = "pci";
		ranges = <0x81000000 0 0	  0x28000000 0 0x00010000   /* downstream I/O */
			  0x82000000 0 0x20000000 0x20000000 0 0x04000000>; /* non-prefetchable memory */
		phy-addr = <5>;
	};

	pcie1: pcie@18013000 {
		compatible = "brcm,iproc-pcie";
		reg = <0x18013000 0x1000>,
			<0x18002000 0x1000>;

		interrupts = <GIC_SPI 106 IRQ_TYPE_NONE>;
		bus-range = <0x00 0xFF>;

		#address-cells = <3>;
		#size-cells = <2>;
		device_type = "pci";
		ranges = <0x81000000 0 0	  0x48000000 0 0x00010000   /* downstream I/O */
			  0x82000000 0 0x40000000 0x40000000 0 0x04000000>; /* non-prefetchable memory */
		phy-addr = <6>;
	};
```

## linux-3.18/Documentation/devicetree/bindings/spi/brcm,qspi.txt
```
Broadcom QSPI controller

The Broadcom QSPI controller is a SPI controller found on various chips
including the iProc. It's designed to interface with serial flash chips,
particularly m25p80-compatible chips.

Required properties:

- compatible: Must be "brcm,qspi".

- reg: Six register ranges are required, in this order:

	MSPI register range 		(QSPI_mspi_SPCR0_LSB, etc)
	BSPI register range 		(QSPI_BSPI_REVISION_ID, etc)
	BSPI_RAF register range 	(QSPI_raf_START_ADDR, etc)
	QSPI interrupt register range 	(QSPI_raf_interrupt_LR_fullness_reached, etc)
	QSPI IDM register 		(QSPI_IDM_IDM_IO_CONTROL_DIRECT)
	CRU control register 		(CRU_control)

- interrupts: One interrupt is required:

	qspi_to_core_mspi_interrupt_done

- clocks: The QSPI reference clock, used to set the SPI serial port baud rate.

SPI slaves should be added as children of the qspi node.

Example:

qspi@18027200 {
	compatible = "brcm,qspi";
	reg = <0x18027200 0x188>,       // MSPI register range
	      <0x18027000 0x50>,        // BSPI register range
	      <0x18027100 0x24>,        // BSPI_RAF register range
	      <0x180273a0 0x1c>,        // QSPI interrupt register range
	      <0x1811c408 0x4>,         // QSPI_IDM_IDM_IO_CONTROL_DIRECT register
	      <0x1803e000 0x4>;         // CRU control register

	interrupts = <GIC_SPI 83 IRQ_TYPE_LEVEL_HIGH>;

	#address-cells = <1>;
	#size-cells = <0>;

	clocks = <&apb_pclk>;

	m25p80@0 {
		compatible = "macronix,mx25l12805d";
		reg = <0>;
		spi-max-frequency = <70000000>;
		m25p,fast-read;
	};
};
```

## linux-3.18/arch/arm/mach-bcm/xldk/Kconfig
```kconfig
config COMMON_CLK_XGS_IPROC
	bool "BRCM XGS iProc clock support"
	depends on COMMON_CLK
	depends on ARCH_BCM_SWITCH_ARM
	help
		Enable common clock framework support for Broadcom SoCs based on the
		iProc architecture.

source arch/arm/mach-bcm/xldk/hr3/Kconfig
```

## linux-3.18/arch/arm/mach-bcm/xldk/hr3/Kconfig
```kconfig
config GPIO_HR3
	tristate "Hurricane 3 GPIO support"
	default y
	depends on ARCH_BCM_SWITCH_ARM
	select GPIO_GENERIC
	select GPIOLIB_IRQCHIP
	help
		Say yes here to enable GPIO support for the Broadcom
		Hurricane 3 SoC.

config PCIE_HR3
	tristate "Hurricane 3 PCIe controller"
	select PCI_DOMAINS
	depends on ARCH_BCM_SWITCH_ARM
	default y
	help
		Say yes here to enable PCIe support for the Broadcom
		Hurricane 3 SoC.
```

## linux-3.18/arch/mips/vcoreiii/Kconfig
```kconfig
config VTSS_VCOREIII_JAGUAR_EVAL
	bool "Support Vitesse Semiconductor VCore-III Jaguar board"
	depends on VTSS_VCOREIII_EVAL
	select VTSS_VCOREIII_JAGUAR
	help
	  This enables support for the Jaguar-based Vitesse Semiconductor
	  VCore-III evaluation board(s).

config VTSS_VCOREIII_JAGUAR_DUAL
       bool "Support Dual Jaguar chips"
       depends on VTSS_VCOREIII_JAGUAR
       help
         This enables support for dual-Jaguar configurations.

config VTSS_VCOREIII_JAGUAR_DUAL_PI_TIMEOUT
       bool "Timeout on slave chip communication failure"
       depends on VTSS_VCOREIII_JAGUAR_DUAL
       help
         This option adds logic that prevents the CPU from hanging
         when an attempt to communicate with a slave chip fails. If
         unsure, say Y here.

config VTSS_VCOREIII_LUTON26_EVAL
	bool "Support Vitesse Semiconductor VCore-III Luton26 board"
	depends on VTSS_VCOREIII_EVAL
	select VTSS_VCOREIII_LUTON26
	help
	  This enables support for the Luton26-based Vitesse Semiconductor
	  VCore-III evaluation board(s).

config VTSS_VCOREIII
       bool

config VTSS_VCOREIII_JAGUAR
       bool

config VTSS_VCOREIII_LUTON26
       bool

choice
	prompt "Kernel binary format"
	depends on VTSS_VCOREIII
	help
	  Select the binary format for the produced kernel. The
	  value selected depends on the boot loader being used.

config BOOT_ELF32
       bool "Generate an Elf-32 format kernel image"
       help
         Create a Elf-32 format kernel image. This image is
	 suitable for the RedBoot and Das U-Boot boot loaders,
	 among others.

config BOOT_ROM_LOADER
       bool "Generate a self-loading ROM image"
       help
         Create an image suitable for direct programming into
	 ROM/FLASH.
endchoice

config BOOT_ROM_LOADER
       bool

config BOOT_ROM_LOADER_PAYLOAD_OFFSET
       hex "Offset from ROM start to image payload"
       depends on BOOT_ROM_LOADER
       default "0x00040000"
       help
         This is the offset in the ROM in which the payload, i.e.
	 the linux kernel image, will reside. The recommended
	 value is the size of an erase block on the flash, which
	 will allow for the payload to be updated independently of
	 the loader. Note that this is the offset from the start
	 of the ROM, not the start of the loader or the ROM physical
	 address.

config VTSS_VCOREIII_PHY8512_GPIO
       tristate "Generic GPIO on the Vitesse 8512 PHY"
       depends on VTSS_VCOREIII && GPIOLIB
       help
         This is a GPIO driver for the VSC8512 PHY. This includes
	 drivers for the PHY via GPIOLIB. To be useful, the platform
	 must explicitly declare the existence of VSC8512 PHYs and
	 their MDIO address.

config VTSS_VCOREIII_PHY8488_GPIO
       tristate "Generic GPIO on the Vitesse 8488 PHY"
       depends on VTSS_VCOREIII && GPIOLIB
       help
         This is a GPIO driver for the VSC8488 PHY. This includes
	 drivers for the PHY via GPIOLIB. To be useful, the platform
	 must explicitly declare the existence of VSC8488 PHYs and
	 their MDIO address.

config VTSS_VCOREIII_SGPIO
       tristate "Generic GPIO on the VCore-III SGPIO"
       depends on VTSS_VCOREIII && GPIOLIB
       help
         This is a GPIO driver for the serial GPIO controllers
	 (including the serial LED controllers) on the Luton and
	 Jaguar chip families.
```

## linux-3.18/drivers/meraki/Kconfig
```kconfig
menu "Meraki devices"

config MERAKI_CONFIG
	tristate "Meraki Board Data support"
	depends on I2C
	help
	  This option enables support for the meraki-config device, which
	  proxies the content of the board ID EEPROM to a known location.

	  It also provides kernel access to the Meraki product type.

	  If your board has a board ID EEPROM on it, say Y here.

config CISCO_MPS
    bool "Cisco MPS Support"
    depends on POWER_SUPPLY
    help
      This is a driver for an I2C-connected MPS device

config CISCO_RPS
       bool "Cisco RPS 2300 driver support"
       depends on I2C && POWER_SUPPLY
       default n
       ---help---
         This option enables support for interfacing with an external
         Cisco RPS 2300 over I2C and GPIOs.

         Say N here if you don't know whether or not your device
         supports the Cisco RPS 2300.

config MERAKI_SFP_USER
       bool "Meraki SFP/SFP+ Socket Support (user-mode)"
       depends on I2C && GPIOLIB
       help
         This is a proxy driver for an I2C-connected SFP/SFP+/QSFP socket.
         The actual driving of the socket will be performed in userspace.

config CISCO_ACT2
       bool "Cisco ACT2 support"
       default n
       help
         This is a driver to communicate with the Cisco ACT2 security chip.
         The device is used for various types of encryption. It has on-board,
         protected EEPROM so it can generate and securely store keys.

config CISCO_ACT2_I2C
	bool "Cisco ACT2 I2C support"
	depends on I2C && CISCO_ACT2
	default n
	help
         This is a driver to communicate with the Cisco ACT2 security chip.
         The device is used for various types of encryption. It has on-board,
         protected EEPROM so it can generate and securely store keys.

         This is an I2C-connected device.

config CISCO_ACT2_SPI
	bool "Cisco ACT2 SPI support"
	depends on SPI && CISCO_ACT2
	default n
	help
         This is a driver to communicate with the Cisco ACT2 security chip.
         The device is used for various types of encryption. It has on-board,
         protected EEPROM so it can generate and securely store keys.

         This is an SPI-connected device.

endmenu
```
