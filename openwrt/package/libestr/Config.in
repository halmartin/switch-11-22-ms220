## openwrt/package/libestr/Config.in
```kconfig
config BR2_PACKAGE_LIBESTR
	prompt "libestr........................... some essentials for string handling (and a bit more)"
	tristate
	default m if CONFIG_DEVEL
	help
          Some essentials for string handling (and a bit more)
```

## openwrt/package/libfastjson/Config.in
```kconfig
config BR2_PACKAGE_LIBFASTJSON
	prompt "libfastjson............................ libfastjson"
	tristate
	default n if CONFIG_DEVEL
	help
          libfastjson
```

## openwrt/package/libfdt/Config.in
```kconfig
config BR2_PACKAGE_LIBFDT
	prompt "libfdt............................ The flattened device tree library"
	tristate
	default n
	help
	  The flattened device tree library
```

## openwrt/package/libffi/Config.in
```kconfig
config BR2_PACKAGE_LIBFFI
	prompt "libffi............................ Foreign Function Interface library"
	tristate
	default n
	help
	  The libffi library provides a portable, high level programming
	  interface to various calling conventions. This allows a programmer to
	  call any function specified by a call interface description at run
	  time.  
	  
	  http://sources.redhat.com/libffi/
```

## openwrt/package/libfontenc/Config.in
```kconfig
config BR2_PACKAGE_LIBFONTENC
        prompt "libfontenc..........................Libfontenc library"
	tristate
	default n
	help
	  Libfontenc library. You probably only need this if you want to
	  install an X server.
```

## openwrt/package/liblogging/Config.in
```kconfig
config BR2_PACKAGE_LIBLOGGING
	prompt "liblogging........................ an easy to use and lightweight signal-safe logging library"
	tristate
	default m if CONFIG_DEVEL
	help
	  Liblogging is an easy to use library for logging. It offers an enhanced replacement for the syslog() call, but retains its ease of use.
```

## openwrt/package/liblzma/Config.in
```kconfig
config BR2_PACKAGE_LIBLZMA
	prompt "liblzma........................... Library for XZ and LZMA compressed files"
	tristate
	default m if CONFIG_DEVEL
	help
	  liblzma is a general purpose data compression library with
	  an API similar to that of zlib. liblzma supports multiple
	  algorithms, of which LZMA2 is currently the primary algorithm.
	  The native file format is .xz, but also the legacy .lzma
	  format and raw streams (no headers at all) are supported.

	  http://tukaani.org/xz/
```

## openwrt/package/libnetfilter-conntrack/Config.in
```kconfig
config BR2_PACKAGE_LIBNETFILTER_CONNTRACK
	prompt "libnetfilter_conntrack............ Linux conntrack utility"
	tristate
	default m if CONFIG_DEVEL
	depends BR2_PACKAGE_LIBNFNETLINK
	help
      linux conntrack package.
```

## openwrt/package/libnfnetlink/Config.in
```kconfig
config BR2_PACKAGE_LIBNFNETLINK
	prompt "libnfnetlink...................... Linux conntrack utility"
	tristate
	default m if CONFIG_DEVEL
	help
      linux conntrack package.
```

## openwrt/package/libpam/Config.in
```kconfig
config BR2_PACKAGE_LIBPAM
	prompt "libpam....................... "
	tristate
	default m if BR2_LINUX_2_6_BRCM && CONFIG_DEVEL
	default m if BR2_LINUX_2_6_X86 && CONFIG_DEVEL
	default n
	help
	  libpam
```

## openwrt/package/libpciaccess/Config.in
```kconfig
config BR2_PACKAGE_LIBPCIACCESS
        prompt "libpciaccess........................X PCI access"
	tristate
	default n
	help
	  X PCI access. You probably only need this if you want to install
	  an X server.
```

## openwrt/package/libradiusbsd/Config.in
```kconfig
config BR2_PACKAGE_LIBRADIUSBSD
	prompt "libradiusbsd............................. "
	tristate
	default n
	help
	  bleh
```

## openwrt/package/libsodium/Config.in
```kconfig
config BR2_PACKAGE_LIBSODIUM
	prompt "libsodium...........................NaCl-based crypto library"
	tristate
	default m if CONFIG_DEVEL
	help
	  NaCl (pronounced "salt") is a new easy-to-use high-speed software
	  library for network communication, encryption, decryption,
	  signatures, etc.  NaCl's goal is to provide all of the core
	  operations needed to build higher-level cryptographic tools.  Sodium
	  is a portable, cross-compilable, installable, packageable fork of
	  NaCl (based on the latest released upstream version nacl-20110221),
	  with a compatible API.  The design choices, particularly in regard to
	  the Curve25519 Diffie-Hellman function, emphasize security (whereas
	  NIST curves emphasize "performance" at the cost of security), and
	  "magic constants" in NaCl/Sodium have clear rationales.  The same
	  cannot be said of NIST curves, where the specific origins of certain
	  constants are not described by the standards.  And despite the
	  emphasis on higher security, primitives are faster across-the-board
	  than most implementations of the NIST standards.

	  https://github.com/jedisct1/libsodium
```

## openwrt/package/libsoup/Config.in
```kconfig
config BR2_PACKAGE_LIBSOUP
	prompt "libsoup............................. HTTP client/server library for GNOME"
	tristate
	default m if CONFIG_DEVEL
	help
	  libsoup is an HTTP client/server library for GNOME. It uses GObjects and the
	  glib main loop, to integrate well with GNOME applications, and also has a
	  synchronous API, for use in threaded applications.

	  https://wiki.gnome.org/Projects/libsoup

	  Depends: glib2, intltool, libxml2
```

## openwrt/package/libstdcxx/Config.in
```kconfig
config BR2_PACKAGE_LIBSTDCXX
	prompt "libstdc++.......................... Standard C++ library"
	tristate
	default m if CONFIG_DEVEL
	help
	  The GNU standard C++ library
```

## openwrt/package/libtirpc/Config.in
```kconfig
config BR2_PACKAGE_LIBTIRPC
        prompt "libtirpc.......................... Sun RPC library"
        bool
        help
          A Sun RPC implementation
```

## openwrt/package/libubacktrace/Config.in
```kconfig
config BR2_PACKAGE_LIBUBACKTRACE
	prompt "libubacktrace............................. "
	tristate
	default n
	help
	  TURN ME ON
```

## openwrt/package/libxau/Config.in
```kconfig
config BR2_PACKAGE_LIBXAU
        prompt "libxau..............................Libxau library"
	tristate
	default n
	help
	  Libxau library. You probably only need this if you want to
	  install an X server.
```

## openwrt/package/libxcb/Config.in
```kconfig
config BR2_PACKAGE_LIBXCB
        prompt "libxcb..............................X C bindings"
	tristate
	default n
	help
	  X C bindings. You probably only need this if you want to install
	  an X server.
```

## openwrt/package/libxext/Config.in
```kconfig
config BR2_PACKAGE_LIBXEXT
        prompt "libxext.............................X common extensions"
	tristate
	default n
	help
	  X common extensions. You probably only need this if you want to
	  install an X server.
```

## openwrt/package/libxkbfile/Config.in
```kconfig
config BR2_PACKAGE_LIBXKBFILE
        prompt "libxkbfile..........................XKB file handling routines"
	tristate
	default n
	help
	  XKB file handling routines. You probably only need this if you
	  want to install an X server.
```

## openwrt/package/lvm2/Config.in
```kconfig
config BR2_PACKAGE_LVM2
	prompt "lvm2......................... lvm2
	tristate
	default m if CONFIG_DEVEL
	help
          lvm2
```

## openwrt/package/mbluez/Config.in
```kconfig
config BR2_COMPILE_MBLUEZ
       tristate
       default n
       depends BR2_PACKAGE_LIBMBLUEZ

config BR2_PACKAGE_LIBMBLUEZ
	prompt "libmbluez......................... libbluetooth for embedded"
	tristate
	default n
        select BR2_COMPILE_MBLUEZ
	help
	  Replacement for bluez-libs.
          Fork of bluez for embedded platforms.
	  
	  Depends: libpthread

config BR2_PACKAGE_MBLUEZ
	prompt "mbluez............................ Bluetooth tools for embedded"
	tristate
	default n
        depends BR2_PACKAGE_LIBMBLUEZ
	help
          Replacement for bluez-utils.
	  Fork of bluez for embedded platforms.
	  
	  Depends: libpthread

config BR2_PACKAGE_MBLUEZ_HCIDUMP
	prompt "hcidump........................... HCI packet capture/dump"
	tristate
	default n
        depends BR2_PACKAGE_LIBMBLUEZ
	help
          Utility for dumping HCI packets.
	  Fork of bluez for embedded platforms.
	  
	  Depends: libpthread
```

## openwrt/package/mdadm/Config.in
```kconfig
config BR2_PACKAGE_MDADM
	prompt "mdadm......................... mdadm"
	tristate
	default m if CONFIG_DEVEL
	help
          mdadm
```

## openwrt/package/memtester/Config.in
```kconfig
config BR2_PACKAGE_MEMTESTER
	prompt "memtester......................... A utility for testing memory."
	tristate
	help
	  memtester allocates memory and tests it.
	  
	  http://pyropus.ca/software/memtester/
```
