## openwrt/package/fixesproto/Config.in
```kconfig
config BR2_PACKAGE_FIXESPROTO
        prompt "fixesproto..........................X fixes extension protocol"
	tristate
	default n
	help
	  X fixes extension protocol. You probably only need this if you
	  want to install an X server.
```

## openwrt/package/flashrom/Config.in
```kconfig
config BR2_PACKAGE_FLASHROM
	prompt "flashrom.......................... BIOS flashing tool"
	tristate
        depends BR2_PACKAGE_PCIUTILS
	default n
	help
	  This tool is used to flash the BIOS/Coreboot Flash.
```

## openwrt/package/fontconfig/Config.in
```kconfig
config BR2_PACKAGE_FONTCONFIG
        prompt "fontconfig........................ Font configuration system"
	tristate
	default n
	help
	  Fontconfig is used for font configuration.
```

## openwrt/package/fontsproto/Config.in
```kconfig
config BR2_PACKAGE_FONTSPROTO
        prompt "fontsproto..........................Fontsproto extension headers"
	tristate
	default n
	help
	  Fontsproto extension headers. You probably only want this if you
	  install an X server.
```

## openwrt/package/freeradius/Config.in
```kconfig
menu "freeradius........................ A Flexible RADIUS server implementation"

config BR2_PACKAGE_FREERADIUS
	prompt "freeradius........................ Flexible RADIUS server"
	tristate
	default m if CONFIG_DEVEL
	select BR2_PACKAGE_LIBLTDL
	select BR2_PACKAGE_LIBOPENSSL
	select BR2_PACKAGE_LIBPTHREAD
	help
	  A flexible RADIUS server
	  
	  http://www.freeradius.org/
	  
	  Depends:
	    - libltdl
	    - libopenssl
	    - libpthread
	    - libmysqlclient (for MySQL support)
	    - libopenldap (for LDAP support)
	    - libpq (for PostgreSQL support)

config BR2_PACKAGE_FREERADIUS_DEMOCERTS
	prompt   "freeradius-democerts............ Demo certificates to test the server"
	tristate
	default m if CONFIG_DEVEL
	depends BR2_PACKAGE_FREERADIUS

config BR2_PACKAGE_FREERADIUS_MOD_CHAP
	prompt   "freeradius-mod-chap............. CHAP module"
	tristate
	default m if CONFIG_DEVEL
	depends BR2_PACKAGE_FREERADIUS

config BR2_PACKAGE_FREERADIUS_MOD_DETAIL
	prompt   "freeradius-mod-detail........... Detailed accounting module"
	tristate
	default m if CONFIG_DEVEL
	depends BR2_PACKAGE_FREERADIUS

config BR2_PACKAGE_FREERADIUS_MOD_EAP
	prompt   "freeradius-mod-eap.............. Base EAP module"
	tristate
	default m if CONFIG_DEVEL
	depends BR2_PACKAGE_FREERADIUS

config BR2_PACKAGE_FREERADIUS_MOD_EAP_GTC
	prompt     "freeradius-mod-eap-gtc........ EAP/GTC module"
	tristate
	default m if CONFIG_DEVEL
	depends BR2_PACKAGE_FREERADIUS_MOD_EAP

config BR2_PACKAGE_FREERADIUS_MOD_EAP_MD5
	prompt     "freeradius-mod-eap-md5........ EAP/MD5 module"
	tristate
	default m if CONFIG_DEVEL
	depends BR2_PACKAGE_FREERADIUS_MOD_EAP

config BR2_PACKAGE_FREERADIUS_MOD_EAP_LEAP
	prompt     "freeradius-mod-eap-leap........ EAP/LEAP module"
	tristate
	default m if CONFIG_DEVEL
	depends BR2_PACKAGE_FREERADIUS_MOD_EAP

config BR2_PACKAGE_FREERADIUS_MOD_EAP_MSCHAPV2
	prompt     "freeradius-mod-eap-mschapv2... EAP/MS-CHAPv2 module"
	tristate
	default m if CONFIG_DEVEL
	depends BR2_PACKAGE_FREERADIUS_MOD_EAP

config BR2_PACKAGE_FREERADIUS_MOD_EAP_PEAP
	prompt     "freeradius-mod-eap-peap....... EAP/PEAP module"
	tristate
	default m if CONFIG_DEVEL
	depends BR2_PACKAGE_FREERADIUS_MOD_EAP

config BR2_PACKAGE_FREERADIUS_MOD_EAP_TLS
	prompt     "freeradius-mod-eap-tls........ EAP/TLS module"
	tristate
	default m if CONFIG_DEVEL
	depends BR2_PACKAGE_FREERADIUS_MOD_EAP

config BR2_PACKAGE_FREERADIUS_MOD_EAP_TTLS
	prompt       "freeradius-mod-eap-ttls..... EAP/TTLS module"
	tristate
	default m if CONFIG_DEVEL
	depends BR2_PACKAGE_FREERADIUS_MOD_EAP_TLS

config BR2_PACKAGE_FREERADIUS_MOD_EXEC
	prompt   "freeradius-mod-exec.............. EXEC module"
	tristate
	default m if CONFIG_DEVEL
	depends BR2_PACKAGE_FREERADIUS

config BR2_PACKAGE_FREERADIUS_MOD_FILES
	prompt   "freeradius-mod-files............ Module using local files for authorization"
	tristate
	default m if CONFIG_DEVEL
	depends BR2_PACKAGE_FREERADIUS

config BR2_PACKAGE_FREERADIUS_MOD_LDAP
	prompt   "freeradius-mod-ldap............. LDAP module"
	tristate
	default m if CONFIG_DEVEL
	select BR2_PACKAGE_LIBOPENLDAP
	depends BR2_PACKAGE_FREERADIUS

config BR2_PACKAGE_FREERADIUS_MOD_MSCHAP
	prompt   "freeradius-mod-mschap........... MS-CHAP and MS-CHAPv2 module"
	tristate
	default m if CONFIG_DEVEL
	depends BR2_PACKAGE_FREERADIUS

config BR2_PACKAGE_FREERADIUS_MOD_PAP
	prompt   "freeradius-mod-pap.............. PAP module"
	tristate
	default m if CONFIG_DEVEL
	depends BR2_PACKAGE_FREERADIUS

config BR2_PACKAGE_FREERADIUS_MOD_PREPROCESS
	prompt   "freeradius-mod-preprocess....... Request pre-processing module"
	tristate
	default m if CONFIG_DEVEL
	depends BR2_PACKAGE_FREERADIUS

config BR2_PACKAGE_FREERADIUS_MOD_REALM
	prompt   "freeradius-mod-realm............ Realms handling module"
	tristate
	default m if CONFIG_DEVEL
	depends BR2_PACKAGE_FREERADIUS

config BR2_PACKAGE_FREERADIUS_MOD_SQL
	prompt   "freeradius-mod-sql.............. Base SQL module"
	tristate
	default m if CONFIG_DEVEL
	depends BR2_PACKAGE_FREERADIUS

config BR2_PACKAGE_FREERADIUS_MOD_SQL_MYSQL
	prompt     "freeradius-mod-sql-mysql...... MySQL module"
	tristate
	default m if CONFIG_DEVEL
	depends BR2_PACKAGE_FREERADIUS_MOD_SQL
	select BR2_PACKAGE_LIBMYSQLCLIENT

config BR2_PACKAGE_FREERADIUS_MOD_SQL_PGSQL
	prompt     "freeradius-mod-sql-pgsql...... PostgreSQL module"
	tristate
	default m if CONFIG_DEVEL
	depends BR2_PACKAGE_FREERADIUS_MOD_SQL
	select BR2_PACKAGE_LIBPQ

config BR2_PACKAGE_FREERADIUS_MOD_SQLCOUNTER
	prompt     "freeradius-mod-sqlcounter..... Generic SQL Counter module"
	tristate
	default m if CONFIG_DEVEL
	depends BR2_PACKAGE_FREERADIUS_MOD_SQL

config BR2_PACKAGE_FREERADIUS_MOD_RADUTMP
	prompt   "freeradius-mod-radutmp.............. RADUTMP module"
	tristate
	default m if CONFIG_DEVEL
	depends BR2_PACKAGE_FREERADIUS

config BR2_PACKAGE_FREERADIUS_MOD_LOGINTIME
	prompt   "freeradius-mod-logintime.............. LOGINTIME module"
	tristate
	default m if CONFIG_DEVEL
	depends BR2_PACKAGE_FREERADIUS

config BR2_PACKAGE_FREERADIUS_MOD_EXPR
	prompt   "freeradius-mod-expr.............. EXPR module"
	tristate
	default m if CONFIG_DEVEL
	depends BR2_PACKAGE_FREERADIUS

config BR2_PACKAGE_FREERADIUS_MOD_ATTR_FILTER
	prompt   "freeradius-mod-attr-filter.............. ATTR_FILTER module"
	tristate
	default m if CONFIG_DEVEL
	depends BR2_PACKAGE_FREERADIUS

config BR2_PACKAGE_FREERADIUS_MOD_EXPIRATION
	prompt   "freeradius-mod-expiration.............. EXPIRATION module"
	tristate
	default m if CONFIG_DEVEL
	depends BR2_PACKAGE_FREERADIUS

config BR2_PACKAGE_FREERADIUS_MOD_ALWAYS
	prompt   "freeradius-mod-always.............. ALWAYS module"
	tristate
	default m if CONFIG_DEVEL
	depends BR2_PACKAGE_FREERADIUS

config BR2_PACKAGE_FREERADIUS_MOD_DIGEST
	prompt   "freeradius-mod-digest.............. DIGEST module"
	tristate
	default m if CONFIG_DEVEL
	depends BR2_PACKAGE_FREERADIUS

config BR2_PACKAGE_FREERADIUS_MOD_UNIX
	prompt   "freeradius-mod-unix.............. UNIX module"
	tristate
	default m if CONFIG_DEVEL
	depends BR2_PACKAGE_FREERADIUS

config BR2_PACKAGE_FREERADIUS_MOD_ACCT_UNIQUE
	prompt   "freeradius-mod-acct-unique.............. ACCT_UNIQUE module"
	tristate
	default m if CONFIG_DEVEL
	depends BR2_PACKAGE_FREERADIUS

config BR2_PACKAGE_FREERADIUS_MOD_CACHE
	prompt   "freeradius-mod-cache.............. CACHE module"
	tristate
	default m if CONFIG_DEVEL
	depends BR2_PACKAGE_FREERADIUS

config BR2_PACKAGE_FREERADIUS_UTILS
	prompt   "freeradius-utils................ Misc. client utilities"
	tristate
	default m if CONFIG_DEVEL
	depends BR2_PACKAGE_FREERADIUS

endmenu
```

## openwrt/package/freeswitch/Config.in
```kconfig
config BR2_PACKAGE_FREESWITCH
	prompt "freeswitch.............................. FreeSWITCH open source telephony platform"
	tristate
	default n if CONFIG_DEVEL
	select BR2_PACKAGE_LIBNCURSES
	select BR2_PACKAGE_LIBPCRE
	select BR2_PACKAGE_LIBREADLINE
	select BR2_PACKAGE_LIBPTHREAD
	select BR2_PACKAGE_LIBGNUTLS
	select BR2_PACKAGE_LIBSPEEX
	select BR2_PACKAGE_LIBSPEEXDSP
	select BR2_PACKAGE_LIBUUID
	select BR2_PACKAGE_LIBJPEG
	select BR2_PACKAGE_SQLITE3
	select BR2_PACKAGE_LIBCURL
	help
    FreeSWITCH is an open source telephony platform designed to facilitate the creation of voice and chat driven products scaling from a soft-phone up to a soft-switch.  It can be used as a simple switching engine, a PBX, a media gateway or a media server to host IVR applications using simple scripts or XML to control the callflow. 
```

## openwrt/package/gettext/Config.in
```kconfig
config BR2_PACKAGE_GETTEXT
	prompt "gettext.......................... Because we need it for glib2"
	tristate
	select BR2_PACKAGE_LIBICONV
	default m if CONFIG_DEVEL
	help
	  The GNU `gettext' utilities are a set of tools that provide a
	  framework to help other GNU packages produce multi-lingual
	  messages.

	  Only the libintl library will be installed in the
	  target. The full gettext suite, including tools, will be
	  installed in the staging directory.

	  http://www.gnu.org/software/gettext/
```

## openwrt/package/glib-networking/Config.in
```kconfig
config BR2_PACKAGE_GLIB-NETWORKING
	prompt "glib-networking............................. a GLIB netwroking library"
	tristate
	default m if CONFIG_DEVEL
	help
	  glib-networking is a GLib module providing cross-platform networking support.
	  Depends: glib2, gnutls, intltool
```

## openwrt/package/glib2/Config.in
```kconfig
config BR2_PACKAGE_GLIB2
	prompt "glib2............................. The GLib library of C routines (v2.42)"
	tristate
	default m if CONFIG_DEVEL
	select BR2_PACKAGE_GETTEXT
	select BR2_PACKAGE_LIBFFI
	select BR2_PACKAGE_LIBPTHREAD
        select BR2_PACKAGE_LIBICONV if BR2_LIBC_MUSL
	help
	  GLib is a library containing many useful C routines for things such
	  as trees, hashes, and lists.

	  http://www.gtk.org/

	  Depends: libpthread
```

## openwrt/package/grub/Config.in
```kconfig
config BR2_PACKAGE_GRUB
	prompt "grub.............................. The Grand Unified Bootloader"
	tristate
	default m if CONFIG_DEVEL
	help
          bleh

	  http://www.nongnu.org/grub/
```

## openwrt/package/haveged/Config.in
```kconfig
config BR2_PACKAGE_HAVEGED
  prompt "haveged......................... A simple entropy daemon"
  tristate
  default n if CONFIG_DEVEL
  help
    A simple entropy daemon
```

## openwrt/package/hping3/Config.in
```kconfig
config BR2_PACKAGE_HPING3
	prompt "hping3.............................. HPING3"
	tristate
	default m if CONFIG_DEVEL
	select BR2_PACKAGE_LIBPCAP
	select BR2_PACKAGE_LIBPTHREAD
	help
          bleh
	  
```

## openwrt/package/i2c-tools/Config.in
```kconfig
config BR2_PACKAGE_I2CTOOLS
	prompt "i2c-tools.......................... Linux I2C Tools"
	tristate
	default m if CONFIG_DEVEL
	help
	  This package contains various utilities for inspecting and setting of
	  devices connected to the I2C bus.
```

## openwrt/package/imagemagick/Config.in
```kconfig
config BR2_PACKAGE_IMAGEMAGICK
	prompt "ImageMagick........................... An image manipulation library"
	tristate
	default m if CONFIG_DEVEL
	help
	  ImageMagick is an image manipulation package which provides
	  software libraries for a wide variety of image manipulation
	  tasks

	  http://www.imagemagick.org/
```

## openwrt/package/inputproto/Config.in
```kconfig
config BR2_PACKAGE_INPUTPROTO
        prompt "inputproto..........................X input protocol extension"
	tristate
	default n
	help
	  X input protocol extensions. You probably only need this if you
	  want to install an X server.
```

## openwrt/package/intltool/Config.in
```kconfig
config BR2_PACKAGE_INTLTOOL
	prompt "intltool............................. Internationalization tool for extracting translatable strings"
	tristate
	default m if CONFIG_DEVEL
	help
	  The Intltool is an internationalization tool used for extracting translatable strings from source files, collecting the extracted strings with messages from traditional source files (<source directory>/<package>/po) and merging the translations into .xml, .desktop and .oaf files.
```

## openwrt/package/json-c/Config.in
```kconfig
config BR2_PACKAGE_JSON-C
	prompt "json-c............................ json-c"
	tristate
	default m if CONFIG_DEVEL
	help
          json-c
```

## openwrt/package/json-glib/Config.in
```kconfig
config BR2_PACKAGE_JSON-GLIB
	prompt "json-glib............................. a JSON library built using GLIB"
	tristate
	default m if CONFIG_DEVEL
	help
	  SON-GLib is a library providing serialization and deserialization support for the JavaScript Object Notation (JSON) format described by RFC 4627.
	  Depends: glib2
```

## openwrt/package/kbproto/Config.in
```kconfig
config BR2_PACKAGE_KBPROTO
        prompt "kbproto.............................X keyboard protocol extension"
	tristate
	default n
	help
	  X keyboard protocol extensions. You probably only need this if you
	  want to install an X server.
```

## openwrt/package/kexec-tools/Config.in
```kconfig
config BR2_PACKAGE_KEXEC_TOOLS
	prompt "kexec tools ...................... allow kexec"
	tristate
	default n
	help
	
	  kexec tools...

menu "Configuration"
	depends on BR2_PACKAGE_KEXEC_TOOLS

config BR2_PACKAGE_KEXEC_TOOLS_STATIC_IN_STAGING
	prompt "kexec (static in staging) ........ kexec for initrd"
	bool
	default n
	help
	  put kexec-static in staging /usr/sbin for initrd

config KEXEC_TOOLS_kdump
	bool
	prompt "kdump support"
	default n
	help
	  Include the kdump utility.

endmenu
```

## openwrt/package/libalsa/Config.in
```kconfig
config BR2_PACKAGE_LIBALSA
	prompt "libalsa............................ (Advanced Linux Sound Architecture) library"
	tristate
	default n if CONFIG_DEVEL
	help
	  This is the library package for alsa, needed by some userspace programs.
	  You must have enabled the ALSA support in the kernel.

	  http://www.alsa-project.org/
```

## openwrt/package/libcares/Config.in
```kconfig
config BR2_PACKAGE_LIBCARES
    prompt "libcares......................... C library for asynchronous DNS requests"
    tristate
    default n
    help
        C-Ares is a C library for asynchronous DNS requests (including
        name resolves)

        https://c-ares.haxx.se/
```

## openwrt/package/libdirectfb/Config.in
```kconfig
config BR2_PACKAGE_LIBDIRECTFB
        prompt "libdirectfb....................... Library for direct framebuffer access"
	tristate
	default n
	help
	  The libdirectfb API provides a mechanism for direct framebuffer
	  access.
```

## openwrt/package/libdrm/Config.in
```kconfig
config BR2_PACKAGE_LIBDRM
        prompt "libdrm............................ Library for direct rendering infrastructure"
	tristate
	default n
	help
	  The libdri API provides a mechanism for direct rendering
	  infrastructure access.
```

## openwrt/package/libecap/Config.in
```kconfig
config BR2_PACKAGE_LIBECAP
	prompt "libecap.......................... ECAP Adapter Library"
	tristate
	default m if CONFIG_DEVEL
	help
	Library for embedded ICAP
```
