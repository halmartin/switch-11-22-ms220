## openwrt/package/mii-tool/Config.in
```kconfig
config BR2_PACKAGE_MIITOOL
	prompt "mii-tool.................. configure media type using MII commands"
	tristate
	default m if CONFIG_DEVEL
	help
	  The mii-tool command allows you to set or autodetect the media type
	  or mii chipset-based ethernet devices. It traditionally had been
	  distributed in the net-tools package. This is a single distribution
	  optimized for embedded systems and fully automated cross/-sysroot-builds
```

## openwrt/package/motiondetector/Config.in
```kconfig
config BR2_PACKAGE_MOTIONDETECTOR
	prompt "motion detector.............................. A tool to detect motion events in video clips"
	tristate
	default n
	help
		Meraki SAD-based motion detection algorithm
```

## openwrt/package/mtd-utils/Config.in
```kconfig
config BR2_PACKAGE_MTD_UTILS
	prompt "mtd-utils......................... Tools for reading/writing NAND flash"
	tristate
	help
	  nanddump flash_eraseall flash_info flash_erase nandwrite utilities
	  
	  http://www.linux-mtd.infradead.org
```

## openwrt/package/nettle/Config.in
```kconfig
config BR2_PACKAGE_NETTLE
	prompt "nettle............................ nettle"
	tristate
	default m if CONFIG_DEVEL
	help
          nettle
```

## openwrt/package/nuttcp/Config.in
```kconfig
config BR2_PACKAGE_NUTTCP
	prompt "nuttcp............................ A program for tcp/udp performance testing"
	tristate
	default n
	help
	  http://nuttcp.org/
```

## openwrt/package/openl2tp/Config.in
```kconfig
config BR2_PACKAGE_OPENL2TP
        prompt "openl2tp.......................... L2TP daemon for use with IPsec"
        tristate
        default m if CONFIG_DEVEL
        select BR2_PACKAGE_PPP
        select BR2_PACKAGE_LIBREADLINE
        select BR2_PACKAGE_LIBTIRPC if BR2_LIBC_MUSL
        help
          An L2TP daemon (requires kernel module PPPoL2TP)
```

## openwrt/package/pam-script/Config.in
```kconfig
config BR2_PACKAGE_PAM_SCRIPT
        prompt "pam-script.......................... PAM script authentication module"
        tristate
        default m if CONFIG_DEVEL
	depends BR2_PACKAGE_LIBPAM
        help
          A PAM plugin to authenticate through scripts
```

## openwrt/package/pam_ldap/Config.in
```kconfig
config BR2_PACKAGE_PAMLDAP
        prompt "pam-ldap.......................... PAM LDAP authentication module"
        tristate
        default m if CONFIG_DEVEL
        help
          A PAM plugin to authenticate through LDAP
```

## openwrt/package/patch/Config.in
```kconfig
config BR2_PACKAGE_PATCH
	prompt "patch................................ Patch"
	tristate
	default n
	help
         GNU Patch.  The Busybox patch is slow and broken. This is the real deal.
```

## openwrt/package/pcm/Config.in
```kconfig
config BR2_PACKAGE_PCM
	prompt "pcm............................... Processor Counter Monitor for monitoring performance and energy metrics"
	tristate
	default n if CONFIG_DEVEL
	select BR2_PACKAGE_LIBPTHREAD
	select BR2_PACKAGE_LIBSTDCXX
	help
	  Processor Counter Monitor (PCM) is an application programming interface
	  (API) and a set of tools based on the API to monitor performance and
	  energy metrics of Intel® Core™, Xeon®, Atom™ and Xeon Phi™ processors.
	  PCM works on Linux, Windows, Mac OS X, FreeBSD and DragonFlyBSD operating
	  systems.

	  https://github.com/opcm/pcm
```

## openwrt/package/pixman/Config.in
```kconfig
config BR2_PACKAGE_PIXMAN
        prompt "pixman............................ Library for pixel manipulation"
	tristate
	default n
	help
	  The pixman API provides a mechanism for pixel manipulation.
```

## openwrt/package/polarssl/Config.in
```kconfig
config BR2_COMPILE_POLARSSL
	tristate
	default n
	depends BR2_PACKAGE_LIBPOLARSSL

config BR2_PACKAGE_LIBPOLARSSL
	prompt "libpolarssl........................ Dummy package for polarssl"
	tristate
	default m if CONFIG_DEVEL
	select BR2_COMPILE_POLARSSL
	help
	  Dummy package for polarssl.
```

## openwrt/package/randrproto/Config.in
```kconfig
config BR2_PACKAGE_RANDRPROTO
        prompt "randrproto..........................X rotate and resize extension protocol"
	tristate
	default n
	help
	  X rotate and resize extension protocol. You probably only need
	  this if you want to install an X server.
```

## openwrt/package/renderproto/Config.in
```kconfig
config BR2_PACKAGE_RENDERPROTO
        prompt "renderproto.........................X rendering extension protocol"
	tristate
	default n
	help
	  X rendering extension protocol. You probably only need this if
	  you want to install an X server.
```

## openwrt/package/rsyslog/Config.in
```kconfig
config BR2_PACKAGE_RSYSLOG
	prompt "rsyslog........................... rocket-fast system for log processing"
	tristate
	default m if CONFIG_DEVEL
        select BR2_PACKAGE_LIBESTR
        select BR2_PACKAGE_LIBFASTJSON
	select BR2_PACKAGE_LIBGNUTLS
	help
	  Rsyslog is a fast syslog tool.
```

## openwrt/package/ruby-net-ssh/Config.in
```kconfig
config BR2_PACKAGE_RUBY_NET_SSH
	prompt "ruby_net_ssh......................... Ruby net::ssh"
	tristate
	default m if CONFIG_DEVEL
	help
	  Ruby.. hopefully you know what it is
```

## openwrt/package/ruby/Config.in
```kconfig
config BR2_PACKAGE_RUBY
	prompt "ruby......................... Ruby"
	tristate
	default m if CONFIG_DEVEL
	help
	  Ruby.. hopefully you know what it is
```

## openwrt/package/slang/Config.in
```kconfig
config BR2_PACKAGE_SLANG
	prompt "slang............................ SLANG"
	bool
	default n
	help
	  SLANG
```

## openwrt/package/spectralfft/Config.in
```kconfig
config BR2_PACKAGE_SPECTRALFFT
	prompt "SPECTRALFFT.............................. A file to process spectral analysis fft"
	tristate
	default m if CONFIG_DEVEL
	help
	  A small utility to take the fft of the spectral data

config BR2_PACKAGE_SPECTRALFFT_WITH_FFTW
	prompt "Enable FFTW support"
	bool
	default y
	depends BR2_PACKAGE_SPECTRALFFT
        depends BR2_PACKAGE_LIBFFTW
```

## openwrt/package/speexdsp/Config.in
```kconfig
config BR2_COMPILE_SPEEXDSP
	tristate
	default n
	depends BR2_PACKAGE_LIBSPEEXDSP

config BR2_PACKAGE_LIBSPEEXDSP
	prompt "libspeexdsp.......................... Open source patent-free speech compression codec"
	tristate
	default n if CONFIG_DEVEL
	select BR2_COMPILE_SPEEXDSP
	help
	  
	  Speex is an Open Source/Free Software patent-free audio compression 
	  format designed for speech. The Speex Project aims to lower the 
	  barrier of entry for voice applications by providing a free 
	  alternative to expensive proprietary speech codecs. Moreover, Speex 
	  is well-adapted to Internet applications and provides useful features 
	  that are not present in most other codecs.
	  
	  http://www.speex.org/
	  
	  This package contains the shared codec library, needed by other programs.
```

## openwrt/package/sscep/Config.in
```kconfig
config BR2_PACKAGE_SSCEP
	prompt "sscep............................. SCEP client tool"
	tristate
	default n if CONFIG_DEVEL
	select BR2_PACKAGE_LIBPCAP
	help
	  A Simple SCEP (Simple Certificate Enrollment Protocol) client
	  
	  http://github.com/certnanny/sscep
```

## openwrt/package/strongswan/Config.in
```kconfig
config BR2_PACKAGE_STRONGSWAN
    prompt "strongswan....................... strongSwan OpenSource IPsec implementation"
    tristate
    select BR2_PACKAGE_LIBOPENSSL
    default n
    help
        strongSwan : the OpenSource IPsec-based VPN Solution

        https://www.strongswan.org/
```

## openwrt/package/uboot-envtools/Config.in
```kconfig
config BR2_PACKAGE_UBOOT_ENVTOOLS
	prompt "uboot-envtools.................... tools for modifying uboot environment variables"
	tristate
	default n
	help
          Tools for modifying uboot environmental variables from userland
```

## openwrt/package/uclibc++/Config.in
```kconfig
config BR2_PACKAGE_UCLIBCXX
	prompt "uClibc++.......................... C++ library for embedded systems"
	tristate
	default m if CONFIG_DEVEL
	help
	  A standard C++ library for embedded systems

choice
	prompt "uClibc++ Version" if BR2_PACKAGE_UCLIBCXX
	default BR2_PACKAGE_UCLIBCXX_VERSION_0_1_11
	help
	  Select the version of uClibc++ you wish to use.

	config BR2_PACKAGE_UCLIBCXX_VERSION_0_1_11
	       bool "uClibc++ 0.1.11"

	config BR2_PACKAGE_UCLIBCXX_VERSION_0_2_2
	       bool "uClibc++ 0.2.2"

endchoice

config BR2_PACKAGE_UCLIBC_VERSION
       string
       default "0.1.11"		if BR2_PACKAGE_UCLIBCXX_VERSION_0_1_11
       default "0.2.2"		if BR2_PACKAGE_UCLIBCCC_VERSION_0_2_2
```

## openwrt/package/unzip/Config.in
```kconfig
config BR2_PACKAGE_UNZIP
	prompt "unzip............................. Archive Utility"
	tristate
	default n if CONFIG_DEVEL
	help
	  Into-ZIP version of 'unzip'.
	  http://www.info-zip.org/
```
