## openwrt/toolchain/gcc/Config.in
```kconfig
# Choose gcc version.
# WARNING -- 2.95 currently only builds for i386, arm, mips*, and powerpc.
# WARNING -- 2.95 does not currently build natively for the target.

if CONFIG_DEVEL
	comment "Gcc Options"
endif


# the choice option below is completely ignored
# if CONFIG_DEVEL isn't set, so we have to set
# these manually ... annoying.
config BR2_GCC_VERSION_3_4_4
	bool
	default y if BR2_LINUX_2_4_BRCM

config BR2_GCC_VERSION_4_0_3
	bool
	default y if BR2_LINUX_2_6_ARUBA

choice
	prompt "GCC compiler Version" if CONFIG_DEVEL
	default BR2_GCC_VERSION_4_0_3 if BR2_LINUX_2_6_ARUBA
	default BR2_GCC_VERSION_3_4_4 if BR2_LINUX_2_4_BRCM
	default BR2_GCC_VERSION_4_2_3 if BR2_LINUX_2_6_ARMEB
	default BR2_GCC_VERSION_3_4_6
	help
	  Select the version of gcc you wish to use.


	config BR2_GCC_VERSION_3_4_4
		bool "gcc 3.4.4"

	config BR2_GCC_VERSION_3_4_5
		bool "gcc 3.4.5"

	config BR2_GCC_VERSION_3_4_6
		bool "gcc 3.4.6"

	config BR2_GCC_VERSION_4_0_2
		bool "gcc 4.0.2"

	config BR2_GCC_VERSION_4_0_3
		bool "gcc 4.0.3"
		
	config BR2_GCC_VERSION_4_1_0
		bool "gcc 4.1.0"

    config BR2_GCC_VERSION_4_1_2
        bool "gcc 4.1.2"

    config BR2_GCC_VERSION_4_2_3
        bool "gcc 4.2.3"

    config BR2_GCC_VERSION_4_4_3
        bool "gcc 4.4.3"

    config BR2_GCC_VERSION_4_4_4
        bool "gcc 4.4.4"

    config BR2_GCC_VERSION_4_5_1
    	bool "gcc 4.5.1"

    config BR2_GCC_VERSION_4_5_3
    	bool "gcc 4.5.3"

    config BR2_GCC_VERSION_4_6_2
	bool "gcc 4.6.2"

    config BR2_GCC_VERSION_4_6_3
	bool "gcc 4.6.3"

    config BR2_GCC_VERSION_4_7_0
	bool "gcc 4.7.0"

    config BR2_GCC_VERSION_4_7_1
	bool "gcc 4.7.1"

    config BR2_GCC_VERSION_4_8_3
	bool "gcc 4.8.3"

    config BR2_GCC_VERSION_5_4_0
	bool "gcc 5.4.0"

    config BR2_GCC_VERSION_6_3_0
	bool "gcc 6.3.0"

    config BR2_GCC_VERSION_6_4_0
	bool "gcc 6.4.0"

    config BR2_GCC_VERSION_7_3_0
	bool "gcc 7.3.0"

endchoice

# more nasty hacks
config BR2_PACKAGE_LIBGCC
	tristate
	default y if BR2_GCC_VERSION_4_0_2 || BR2_GCC_VERSION_4_0_3 || BR2_GCC_VERSION_4_1_0 || BR2_GCC_VERSION_4_1_2 || BR2_GCC_VERSION_4_2_3
	default m if CONFIG_DEVEL
	default n

config BR2_GCC_VERSION
	string
	default "3.4.4"     if BR2_GCC_VERSION_3_4_4
	default "3.4.5"     if BR2_GCC_VERSION_3_4_5
	default "3.4.6"     if BR2_GCC_VERSION_3_4_6
	default "4.0.2"     if BR2_GCC_VERSION_4_0_2
	default "4.0.3"     if BR2_GCC_VERSION_4_0_3
	default "4.1.0"     if BR2_GCC_VERSION_4_1_0
	default "4.1.2"     if BR2_GCC_VERSION_4_1_2
	default "4.2.3"     if BR2_GCC_VERSION_4_2_3
	default "4.4.3"	    if BR2_GCC_VERSION_4_4_3
	default "4.4.4"	    if BR2_GCC_VERSION_4_4_4
	default "4.5.1"	    if BR2_GCC_VERSION_4_5_1
	default "4.5.3"	    if BR2_GCC_VERSION_4_5_3
	default "4.6.2"	    if BR2_GCC_VERSION_4_6_2
	default "4.6.3"	    if BR2_GCC_VERSION_4_6_3
	default "4.7.0"	    if BR2_GCC_VERSION_4_7_0
	default "4.7.1"	    if BR2_GCC_VERSION_4_7_1
	default "4.8.3"	    if BR2_GCC_VERSION_4_8_3
	default "5.4.0"	    if BR2_GCC_VERSION_5_4_0
	default "6.3.0"	    if BR2_GCC_VERSION_6_3_0
	default "6.4.0"	    if BR2_GCC_VERSION_6_4_0
	default "7.3.0"	    if BR2_GCC_VERSION_7_3_0
	default "4.2.3"


config BR2_GCC_USE_SJLJ_EXCEPTIONS
	string
#	default "--enable-sjlj-exceptions"
	default ""
	help
	    Currently the unwind stuff seems to work for staticly linked apps
	    but not dynamic.  So use setjmp/longjmp exceptions by default.

config BR2_EXTRA_GCC_CONFIG_OPTIONS
	string
	prompt "Additional gcc options" if CONFIG_DEVEL
	default ""
	help
	    Any additional gcc options you may want to include....

config BR2_INSTALL_LIBSTDCPP
	bool
	prompt "Build/install c++ compiler and libstdc++?" if CONFIG_DEVEL
	default y
	help
	    Build/install c++ compiler and libstdc++?

config INSTALL_LIBGCJ
        bool
        prompt "Build/install java compiler and GNU classpath ?" if TOOLCHAINOPTS
        default n
        help
            Build/install java compiler and GNU classpath ?
```

## openwrt/toolchain/gdb/Config.in
```kconfig
comment "Gdb Options"

config BR2_PACKAGE_GDB_CLIENT
	bool "Build gdb client for the Host"
	default n
	help
	    Build gdb to run on the host to debug programs running on the target.

config BR2_TARGET_DEBUGGER_INFO
       bool "Compile target binaries with debugging information"
       default n
       depends BR2_PACKAGE_GDB_CLIENT
       help
            Compile the target binaries with debugging information. This
	    will increase the size of the binaries on the debugging host,
	    but not on the target system. Without this enabled, gdb
	    is mostly useless. Enable this feature unless you are
	    very limited on disk space on your development system.
```

## openwrt/toolchain/musl/Config.in
```kconfig
if BR2_LIBC_MUSL
comment "musl options"

choice
	prompt "musl Version"
	depends BR2_LIBC_MUSL
	default BR2_MUSL_VERSION_1_1_19

	help
	  Select the version of musl you wish to use.


	config BR2_MUSL_VERSION_1_1_18
		bool "musl 1.1.18"
	config BR2_MUSL_VERSION_1_1_19
		bool "musl 1.1.19"

endchoice

config BR2_MUSL_VERSION
	string
	depends BR2_LIBC_MUSL
	default "1.1.18" if BR2_MUSL_VERSION_1_1_18
        default "1.1.19" if BR2_MUSL_VERSION_1_1_19

endif
```

## openwrt/toolchain/uClibc/Config.in
```kconfig
# Choose uClibc options
#

if BR2_LIBC_UCLIBC
comment "uClibc Options"

choice
	prompt "uClibc Version" if CONFIG_DEVEL
	default BR2_UCLIBC_VERSION_0_9_29 if !BR2_i386
	default BR2_UCLIBC_VERSION_0_9_31 if BR2_i386

	help
	  Select the version of uClibc you wish to use.

	config BR2_UCLIBC_VERSION_0_9_29
	       bool "uClibc 0.9.29"

	config BR2_UCLIBC_VERSION_0_9_31
	       bool "uClibc 0.9.31"

	config BR2_UCLIBC_VERSION_0_9_33
	       bool "uClibc 0.9.33"

        config BR2_UCLIBC_VERSION_1_0_17
               bool "uClibc-ng 1.0.17"

	config BR2_UCLIBC_VERSION_SNAPSHOT
	       bool "uClibc daily snapshot" if CONFIG_DEVEL

endchoice

config BR2_UCLIBC_VERSION
       string
       default "0.9.29" if BR2_UCLIBC_VERSION_0_9_29
       default "0.9.31" if BR2_UCLIBC_VERSION_0_9_31
       default "0.9.33.2" if BR2_UCLIBC_VERSION_0_9_33
       default "1.0.17" if BR2_UCLIBC_VERSION_1_0_17
       default "snapshot" if BR2_UCLIBC_VERSION_SNAPSHOT

endif
```
