## openwrt/package/usb-modeswitch/Config.in
```kconfig
config BR2_PACKAGE_USB_MODESWITCH
	prompt   "usb-modeswitch.................... Enables modem on select USB 3G Dongles"
	tristate
	default n
	depends BR2_PACKAGE_LIBUSB
```

## openwrt/package/util-linux/Config.in
```kconfig
menu "util-linux"

config BR2_COMPILE_UTIL_LINUX
	tristate
	default n
	depends BR2_PACKAGE_FDISK || BR2_PACKAGE_SWAP_UTILS || \
		BR2_PACKAGE_LIBFDISK || BR2_PACKAGE_LIBUUID || \
		BR2_PACKAGE_LIBBLKID || BR2_PACKAGE_MOUNT || \
		BR2_PACKAGE_LIBMOUNT || BR2_PACKAGE_LIBSMARTCOLS

config BR2_PACKAGE_FDISK
	prompt "fdisk............................. Partition table manipulation utility"
	tristate
	default m if CONFIG_DEVEL
	select BR2_COMPILE_UTIL_LINUX
	select BR2_PACKAGE_LIBFDISK
	select BR2_PACKAGE_LIBUUID
	select BR2_PACKAGE_LIBBLKID
	help
	  A partition table manipulation utility
	  
	  http://www.kernel.org/pub/linux/utils/util-linux/

config BR2_PACKAGE_MOUNT
	prompt "mount............................. Filesystem mount utility"
	tristate
	default n
	select BR2_COMPILE_UTIL_LINUX
	select BR2_PACKAGE_LIBMOUNT
	select BR2_PACKAGE_LIBUUID
	select BR2_PACKAGE_LIBBLKID	   
	help
	  A filesystem mount utility
	  
	  http://www.kernel.org/pub/linux/utils/util-linux/

config BR2_PACKAGE_FINDFS
	prompt "findfs............................ Filesystem find utility"
	tristate
	default n
	select BR2_COMPILE_UTIL_LINUX
	select BR2_PACKAGE_LIBUUID
	select BR2_PACKAGE_LIBBLKID	   
	help
	  A filesystem find utility
	  
	  http://www.kernel.org/pub/linux/utils/util-linux/

config BR2_PACKAGE_LIBFDISK
	prompt "libfdisk.......................... Partition table manipulation library"
	tristate
	default n
	select BR2_COMPILE_UTIL_LINUX
	select BR2_PACKAGE_LIBBLKID
	select BR2_PACKAGE_LIBUUID
	help
	  A partition table manipulation library

	  http://www.kernel.org/pub/linux/utils/util-linux/

config BR2_PACKAGE_LIBUUID
	prompt "libuuid........................... UUID manipulation library"
	tristate
	default n
	select BR2_COMPILE_UTIL_LINUX
	help
	  UUID manipulation library

	  http://www.kernel.org/pub/linux/utils/util-linux/

config BR2_PACKAGE_LIBBLKID
	prompt "libblkid.......................... blkid library"
	tristate
	default n
	select BR2_COMPILE_UTIL_LINUX
	select BR2_PACKAGE_LIBUUID
	help
	  http://www.kernel.org/pub/linux/utils/util-linux/

config BR2_PACKAGE_LIBMOUNT
	prompt "libmount.......................... Filesystem mount library"
	tristate
	default n
	select BR2_COMPILE_UTIL_LINUX
	select BR2_PACKAGE_LIBBLKID
        select BR2_PACKAGE_LIBUUID
	help
	  http://www.kernel.org/pub/linux/utils/util-linux/

config BR2_PACKAGE_LIBSMARTCOLS
	prompt "libsmartcols...................... Column display library"
	tristate
	default n
	select BR2_COMPILE_UTIL_LINUX
        help
	  http://www.kernel.org/pub/linux/utils/util-linux/
        
config BR2_PACKAGE_LOSETUP
	prompt "losetup........................... Loop devices setup and control utility"
	tristate
	default m if CONFIG_DEVEL
	select BR2_COMPILE_UTIL_LINUX
	select BR2_PACKAGE_KMOD_LOOP
	select BR2_PACKAGE_LIBSMARTCOLS
	help
	  A loop devices setup and control utility
	  
	  http://www.kernel.org/pub/linux/utils/util-linux/

config BR2_PACKAGE_SWAP_UTILS
	prompt "swap-utils........................ Swap space management utilities"
	tristate
	default m if CONFIG_DEVEL
	select BR2_COMPILE_UTIL_LINUX
	select BR2_PACKAGE_LIBMOUNT
	select BR2_PACKAGE_LIBUUID
	select BR2_PACKAGE_LIBBLKID
	select BR2_PACKAGE_LIBSMARTCOLS
	help
	  A collection of tools to manage swap space :
	    * mkswap
	    * swapon
	    * swapoff
	  
	  http://www.kernel.org/pub/linux/utils/util-linux/

config BR2_PACKAGE_UNSHARE
	prompt "unshare........................... Unshare namespace utility"
	tristate
	default n
	select BR2_COMPILE_UTIL_LINUX
	help
	  The linux unshare utility
	  
	  http://www.kernel.org/pub/linux/utils/util-linux/

config BR2_PACKAGE_NSENTER
	prompt "nsenter........................... nsenter namespace utility"
	tristate
	default n
	select BR2_COMPILE_UTIL_LINUX
	help
	  The linux nsenter utility
	  
	  http://www.kernel.org/pub/linux/utils/util-linux/

endmenu
```

## openwrt/package/valgrind/Config.in
```kconfig
config BR2_PACKAGE_VALGRIND
	prompt "valgrind.......................... Profile and debug tool"
	bool
	default n
	help
          Tool for debugging and profiling Linux programs.

          http://valgrind.kde.org/
```

## openwrt/package/videoproto/Config.in
```kconfig
config BR2_PACKAGE_VIDEOPROTO
        prompt "videoproto..........................Videoproto extension headers"
	tristate
	default n
	help
	  Videoproto extension headers. You probably only want this if you
	  install an X server.
```

## openwrt/package/wmi-client/Config.in
```kconfig
config BR2_COMPILE_WMI_CLIENT
	tristate
	default n
	depends BR2_PACKAGE_LIBSASL2 && BR2_PACKAGE_LIBICONV

config BR2_PACKAGE_WMI_CLIENT
	prompt "wmi-client.................... A Windows Management Interface client"
	tristate
	default m if CONFIG_DEVEL
	select BR2_COMPILE_WMI_CLIENT
	help
	 A WMI client extracted from Samba4, packaged by OpenVAS
	 http://www.openvas.org/download/wmi/
```

## openwrt/package/xcmiscproto/Config.in
```kconfig
config BR2_PACKAGE_XCMISCPROTO
        prompt "xcmiscproto........................ XCMisc extension headers"
	tristate
	default n
	help
	  XCMisc extension headers. You probably only want this if you
	  install an X server.
```

## openwrt/package/xextproto/Config.in
```kconfig
config BR2_PACKAGE_XEXTPROTO
        prompt "xextproto...........................X extension protocol headers"
	tristate
	default n
	help
	  X extension protocol headers. You probably only need this if
	  you want to install an X server.
```

## openwrt/package/xf86-input-keyboard/Config.in
```kconfig
config BR2_PACKAGE_XF86_INPUT_KEYBOARD
	prompt "xf86-input-keyboard................ X server keyboard input driver"
	tristate
	default m if CONFIG_DEVEL
	help
	  X window server keyboard driver. You probably only need this
	  if you are building an X server.
```

## openwrt/package/xf86-input-mouse/Config.in
```kconfig
config BR2_PACKAGE_XF86_INPUT_MOUSE
	prompt "xf86-input-mouse................... X server mouse input driver"
	tristate
	default m if CONFIG_DEVEL
	help
	  X window server mouse driver. You probably only need this
	  if you are building an X server.
```

## openwrt/package/xf86-video-fbdev/Config.in
```kconfig
config BR2_PACKAGE_XF86_VIDEO_FBDEV
	prompt "xf86-video-fbdev................... X server frame buffer video driver"
	tristate
	default m if CONFIG_DEVEL
	help
	  X window server frame buffer driver. You probably only need this
	  if you are building an X server.
```

## openwrt/package/xfont/Config.in
```kconfig
config BR2_PACKAGE_XFONT
        prompt "xfont...............................Xfont library"
	tristate
	default n
	help
	  Xfont library. You probably only need this if you want to
	  install an X server.
```

## openwrt/package/xkbcomp/Config.in
```kconfig
config BR2_PACKAGE_XKBCOMP
	prompt "xkbcomp............................ X server keyboard compiler"
	tristate
	default m if CONFIG_DEVEL
	help
	  X window server keyboard compiler. You probably only need this
	  if you are building an X server.
```

## openwrt/package/xkeyboard-config/Config.in
```kconfig
config BR2_PACKAGE_XKEYBOARD_CONFIG
	prompt "X keyboard configurator............. X server keyboard configurator"
	tristate
	default m if CONFIG_DEVEL
	help
	  X window server keyboard configurator. You probably only need this
	  if you are building an X server.
```

## openwrt/package/xlib/Config.in
```kconfig
config BR2_PACKAGE_XLIB
        prompt "xlib................................Xlib library"
	tristate
	default n
	help
	  Xlib library. You probably only need this if you want to
	  install an X server.
```

## openwrt/package/xmlsec1/Config.in
```kconfig
config BR2_PACKAGE_XMLSEC1
       prompt "xmlsec1..............................XML security library based on libxml2"
       tristate
       select BR2_PACKAGE_LIBXML2
       select BR2_PACKAGE_LIBOPENSSL
       default m if CONFIG_DEVEL
       help
         An XML security library supporting major XML security standards: signature, encryption, canonical, exclusive canonical

         https://www.aleksey.com/xmlsec/
```

## openwrt/package/xorg-server/Config.in
```kconfig
config BR2_PACKAGE_XORG_SERVER
	prompt "Xorg-server....................... The X Window System Server"
	tristate
	default m if CONFIG_DEVEL
	help
	  The X Window System is the standard graphics server used
	  on Unix systems and more.

	  http://www.x.org
```

## openwrt/package/xproto/Config.in
```kconfig
config BR2_PACKAGE_XPROTO
        prompt "xproto..............................X protocol headers"
	tristate
	default n
	help
	  X protocol headers. You probably only need this if you want to
	  install an X server.
```

## openwrt/package/xtrans/Config.in
```kconfig
config BR2_PACKAGE_XTRANS
        prompt "xtrans..............................X transport library"
	tristate
	default n
	help
	  X transport library. You probably only need this if you want to
	  install an X server.
```

## openwrt/target/Config.in
```kconfig
choice
	prompt "Target System"
	default BR2_LINUX_2_4_BRCM
	
config BR2_LINUX_2_6_AR7100
    bool "Atheros AR7100 [2.6]"
    select BR2_mips
    help
      Build firmware images for Atheros AR7100 based boards
      (e.g. Trendnet ... merbe?)

config BR2_LINUX_2_6_ELEMENTAL
    bool "Meraki Elemental [2.6]"
    select BR2_mipsel
    help
      Build firmware images for Meraki Elemental

config BR2_LINUX_2_6_X86
	bool "x86 [2.6]"
	select BR2_i386
	select BR2_LINUX_PCMCIA_SUPPORT
	help
	  Build firmware images for x86 based boards
	  (e.g. Soekris net4521 and net4801, PC Engines WRAP...)

config BR2_LINUX_2_6_X86_64
	bool "x86 [2.6] 64 bit"
	select BR2_x86_64
	select BR2_LINUX_PCMCIA_SUPPORT
	help
	  Build firmware images for x86 based boards
	  (e.g. Soekris net4521 and net4801, PC Engines WRAP...)

if CONFIG_DEVEL

config BR2_LINUX_2_6_ARM
	bool "UNSUPPORTED little-endian arm platform"
	select BR2_arm

config BR2_LINUX_2_6_ARM64
	bool "UNSUPPORTED little-endian arm64 platform"
	select BR2_arm64

config BR2_LINUX_2_6_ARMEB
	bool "UNSUPPORTED big-endian arm platform"
	select BR2_armeb

config BR2_LINUX_2_6_CRIS
	bool "UNSUPPORTED cris platform"
	select BR2_cris

config BR2_LINUX_2_6_M68K
	bool "UNSUPPORTED m68k platform"
	select BR2_m68k

config BR2_LINUX_2_6_POWERPC
	bool "UNSUPPORTED powerpc platform"
	select BR2_powerpc

config BR2_LINUX_2_6_SH3
	bool "UNSUPPORTED little-endian sh3 platform"
	select BR2_sh3

config BR2_LINUX_2_6_SH3EB
	bool "UNSUPPORTED big-endian sh3 platform"
	select BR2_sh3eb

config BR2_LINUX_2_6_SH4
	bool "UNSUPPORTED little-endian sh4 platform"
	select BR2_sh4

config BR2_LINUX_2_6_SH4EB
	bool "UNSUPPORTED big-endian sh4 platform"
	select BR2_sh4eb

config BR2_LINUX_2_6_SPARC
	bool "UNSUPPORTED sparc platform"
	select BR2_sparc

endif

endchoice

config BR2_LINUX_PCMCIA_SUPPORT
	bool
	default n
	depends BR2_LINUX_2_4_X86 || BR2_LINUX_2_4_BRCM || BR2_LINUX_2_6_X86 || BR2_LINUX_2_6_BRCM
```

## openwrt/toolchain/asn1c/Config.in
```kconfig
comment "asn1c options"

config BR2_PACKAGE_ASN1C
        bool "build asn1c compiler/toolkit for the host"
        default n
        help
            Build asn1c for compiling ASN marshall/unmarshall code for the target.
```

## openwrt/toolchain/binutils/Config.in
```kconfig
# Choose binutils version.

if CONFIG_DEVEL
	comment "Binutils Options"
endif

choice
	prompt "Binutils Version" if CONFIG_DEVEL
	default BR2_BINUTILS_VERSION_2_19
	help
	  Select the version of binutils you wish to use.

	config BR2_BINUTILS_VERSION_2_15_94_0_2
		bool "binutils 2.15.94.0.2"

	config BR2_BINUTILS_VERSION_2_16_1
		bool "binutils 2.16.1"

	config BR2_BINUTILS_VERSION_2_16_90_0_3
		bool "binutils 2.16.90.0.3"

	config BR2_BINUTILS_VERSION_2_16_91_0_1
		bool "binutils 2.16.91.0.1"

	config BR2_BINUTILS_VERSION_2_16_91_0_2
		bool "binutils 2.16.91.0.2"

	config BR2_BINUTILS_VERSION_2_16_91_0_6
		bool "binutils 2.16.91.0.6"

	config BR2_BINUTILS_VERSION_2_19
		bool "binutils 2.19"

	config BR2_BINUTILS_VERSION_2_20_1
		bool "binutils 2.20.1"

        config BR2_BINUTILS_VERSION_2_21_1
               bool "binutils 2.21.1"

        config BR2_BINUTILS_VERSION_2_24
               bool "binutils 2.24"

        config BR2_BINUTILS_VERSION_2_25
                bool "binutils 2.25"

        config BR2_BINUTILS_VERSION_2_27
                bool "binutils 2.27"

        config BR2_BINUTILS_VERSION_2_29_1
                bool "binutils 2.29.1"

endchoice

config BR2_BINUTILS_VERSION
	string
	default "2.15.94.0.2"     if BR2_BINUTILS_VERSION_2_15_94_0_2
	default "2.16.1"          if BR2_BINUTILS_VERSION_2_16_1
	default "2.16.90.0.3"     if BR2_BINUTILS_VERSION_2_16_90_0_3
	default "2.16.91.0.1"     if BR2_BINUTILS_VERSION_2_16_91_0_1
	default "2.16.91.0.2"     if BR2_BINUTILS_VERSION_2_16_91_0_2
	default "2.16.91.0.6"     if BR2_BINUTILS_VERSION_2_16_91_0_6
	default "2.19"            if BR2_BINUTILS_VERSION_2_19 || !CONFIG_DEVEL
	default "2.20.1"	  if BR2_BINUTILS_VERSION_2_20_1
	default "2.21.1"	  if BR2_BINUTILS_VERSION_2_21_1
	default "2.24"		  if BR2_BINUTILS_VERSION_2_24
        default "2.25"            if BR2_BINUTILS_VERSION_2_25
        default "2.27"            if BR2_BINUTILS_VERSION_2_27
        default "2.29.1"          if BR2_BINUTILS_VERSION_2_29_1
```
